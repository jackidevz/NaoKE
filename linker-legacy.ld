/* ***************************************************************************** */
/* *                                                                           * */
/* *                                                               ::::::::::  * */
/* *  linker-legacy.ld                                            :+:+:+:+:+   * */
/* *                                                                 +:+       * */
/* *  By: Jack (Khalid Oumouh)                                      +#+        * */
/* *                                                               +#+         * */
/* *  Created: 2026/07/10 06:17 by Jack                    #+#    #+#          * */
/* *  Updated: 2026/07/10 12:24 by Jack                     ########           * */
/* *                                                                           * */
/* ***************************************************************************** */


ENTRY(_start)

SECTIONS
{
    . = 0x8000;

    .text   : ALIGN(16) { KEEP(*(.entry)) *(.text) }
    .rodata : ALIGN(16) { *(.rodata) }
    .data   : ALIGN(16) { *(.data) }
    .bss    : ALIGN(16)
    {
        __bss_start = .;
        *(COMMON)
        *(.bss)
        __bss_end = .;
    }
}
